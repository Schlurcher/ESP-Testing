## main/Kconfig.projbuild
```kconfig
menu "Configuration"

    choice I2C_MASTER_FREQ
        prompt "I2C Master Clock Frequency"
        default I2C_MASTER_FREQ_100K
        help
            Select the I2C master clock frequency.

        config I2C_MASTER_FREQ_100K
            bool "100 KHz (Standard Mode)"

        config I2C_MASTER_FREQ_400K
            bool "400 KHz (Fast Mode)"
        endchoice

    config I2C_MASTER_FREQ_HZ
        int
        default 100000 if I2C_MASTER_FREQ_100K
        default 400000 if I2C_MASTER_FREQ_400K

    menu "I2C Master 0"
    endmenu

    config I2C_MASTER_0_SDA
        int "I2C Master 0 SDA GPIO"
        default 11
        help
            GPIO number for I2C Master 0 SDA.

    config I2C_MASTER_0_SCL
        int "I2C Master 0 SCL GPIO"
        default 12
        help
            GPIO number for I2C Master 0 SCL.


    menu "I2C Master 1"
    endmenu


    config I2C_MASTER_1_SDA
        int "I2C Master 1 SDA GPIO"
        default 7
        help
            GPIO number for I2C Master 1 SDA.

    config I2C_MASTER_1_SCL
        int "I2C Master 1 SCL GPIO"
        default 8
        help
            GPIO number for I2C Master 1 SCL.

endmenu
```
